## legacy_esp_idf/firmware/main/Kconfig.projbuild
```kconfig
menu "MushFarm"

config MF_SENSORS_MOCK
    bool "Use mock sensor values (CI / bench without I2C)"
    default y
    help
        When enabled, SCD41 path returns synthetic RH/CO2/T.
        Disable on real hardware to use I2C drivers.

config MF_WIFI_SOFTAP
    bool "Enable Wi-Fi SoftAP + captive-friendly stack (Sprint 6)"
    default y

config MF_HTTP_API
    bool "Enable HTTP /api/v1 subset (Sprint 6)"
    default y
    depends on MF_WIFI_SOFTAP

config MF_MQTT_ENABLE
    bool "Enable MQTT client task (Sprint 7)"
    default n

config MF_SD_LOG_ENABLE
    bool "Enable SD card FAT mount for logs (Sprint 8)"
    default n

config MF_AUTO_DEMO_CYCLE
    bool "Auto-select embedded demo recipe and start cycle (lab only)"
    default y

config MF_MQTT_BROKER_URI
    string "MQTT broker URI (Sprint 7)"
    default "mqtt://192.168.1.10"
    depends on MF_MQTT_ENABLE

endmenu
```

## legacy_esp_idf/firmware/sdkconfig.defaults
```kconfig
# Logging
CONFIG_LOG_DEFAULT_LEVEL_INFO=y
CONFIG_LOG_MAXIMUM_LEVEL_VERBOSE=y

# CPU
CONFIG_ESP_DEFAULT_CPU_FREQ_MHZ_240=y

# Wi-Fi (Sprint 6)
CONFIG_ESP_WIFI_SOFTAP_SUPPORT=y
CONFIG_ESP_WIFI_STATIC_RX_BUFFER_NUM=10
CONFIG_ESP_WIFI_DYNAMIC_RX_BUFFER_NUM=32

# MQTT (Sprint 7)
CONFIG_MQTT_PROTOCOL_311=y

# SNTP (Sprint 8)
CONFIG_LWIP_SNTP_MAX_SERVERS=3

# FAT / SD (Sprint 8) — enable when wiring SDMMC
CONFIG_FATFS_LFN_HEAP=y

# FreeRTOS
CONFIG_FREERTOS_HZ=1000

# MushFarm Kconfig defaults
CONFIG_MF_SENSORS_MOCK=y
CONFIG_MF_WIFI_SOFTAP=y
CONFIG_MF_HTTP_API=y
CONFIG_MF_MQTT_ENABLE=n
CONFIG_MF_SD_LOG_ENABLE=n
```
